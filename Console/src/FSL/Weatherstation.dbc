VERSION "HIPBNNNYNNNNNNNNNNNNNNNNNNNNNNNNNNNYNNNNNN>N>*N#*N>N/4/%NNN4/'"

NS_ :

BS_:

BU_:

BO_ 102 Humidity: 5 Vector__XXX
 SG_ Air : 0|8@1+ (1,0) [0|100] "%" Vector__XXX
 SG_ DewPoint : 8|32@1- (1,0) [-60|60] "°C" Vector__XXX

BO_ 101 Pressure: 4 Vector__XXX
 SG_ Air : 0|32@1- (1,0) [700|1100] "hPa" Vector__XXX

BO_ 103 Wind: 8 Vector__XXX
 SG_ Speed : 0|32@1- (1,0) [0|350] "km/h" Vector__XXX
 SG_ Direction : 32|16@1+ (1,0) [0|359] "°" Vector__XXX

BO_ 105 Radiation: 4 Vector__XXX
 SG_ Solar : 0|32@1- (1,0) [0|1800] "W/m²" Vector__XXX

BO_ 104 Rainfall: 4 Vector__XXX
 SG_ Hourly : 0|16@1+ (1,0) [0|500] "mm/h" Vector__XXX
 SG_ Daily : 0|16@1+ (1,0) [0|1000] "mm/d" Vector__XXX

BO_ 100 Temperature: 4 Vector__XXX
 SG_ Air : 0|32@1- (1,0) [-60|60] "°C" Vector__XXX

CM_ "database for weather station";
BA_DEF_ BO_  "GenMsgCycleTime" INT 0 1000000;
BA_DEF_ BO_  "CANFD_BRS" ENUM  "0","1";
BA_DEF_  "DBName" STRING ;
BA_DEF_ BO_  "VFrameFormat" ENUM  "StandardCAN","ExtendedCAN","reserved","reserved","reserved","reserved","reserved","reserved","reserved","reserved","reserved","reserved","reserved","reserved","StandardCAN_FD","ExtendedCAN_FD";
BA_DEF_DEF_  "GenMsgCycleTime" 0;
BA_DEF_DEF_  "CANFD_BRS" "1";
BA_DEF_DEF_  "DBName" "";
BA_DEF_DEF_  "VFrameFormat" "StandardCAN";
BA_ "DBName" "Weatherstation";
BA_ "GenMsgCycleTime" BO_ 102 1000;
BA_ "GenMsgCycleTime" BO_ 101 1000;
BA_ "GenMsgCycleTime" BO_ 103 10000;
BA_ "GenMsgCycleTime" BO_ 105 1000;
BA_ "GenMsgCycleTime" BO_ 104 200;
BA_ "GenMsgCycleTime" BO_ 100 10000;
SIG_VALTYPE_ 102 DewPoint : 1;
SIG_VALTYPE_ 101 Air : 1;
SIG_VALTYPE_ 103 Speed : 1;
SIG_VALTYPE_ 105 Solar : 1;
SIG_VALTYPE_ 100 Air : 1;
